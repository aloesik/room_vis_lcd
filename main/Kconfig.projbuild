## main/Kconfig.projbuild
```kconfig
menu "ESP32-S3-Touch-LCD-7 Configuration"
    menu "LVGL GPIO assignment"
        config LCD_VSYNC_GPIO
            int "VSYNC GPIO"
            default 3
            help
                GPIO pin number for VSYNC signal.
        config LCD_HSYNC_GPIO
            int "HSYNC GPIO"
            default 46
            help
                GPIO pin number for HSYNC signal.
        config LCD_DE_GPIO
            int "DE GPIO"
            default 5
            help
                GPIO pin number for DE signal.
        config LCD_PCLK_GPIO
            int "PCLK GPIO"
            default 7
            help
                GPIO pin number for PCLK signal.
        config LCD_D0_B3_GPIO
            int "DATA0 BLUE3 GPIO"
            default 14
            help
                GPIO pin number for data bus[0].
        config LCD_D1_B4_GPIO
            int "DATA1 BLUE4 GPIO"
            default 38
            help
                GPIO pin number for data bus[1].
        config LCD_D2_B5_GPIO
            int "DATA2 BLUE5 GPIO"
            default 18
            help
                GPIO pin number for data bus[2].
        config LCD_D3_B6_GPIO
            int "DATA3 BLUE6 GPIO"
            default 17
            help
                GPIO pin number for data bus[3].
        config LCD_D4_B7_GPIO
            int "DATA4 BLUE7 GPIO"
            default 10
            help
                GPIO pin number for data bus[4].
        config LCD_D5_G2_GPIO
            int "DATA5 GREEN2 GPIO"
            default 39
            help
                GPIO pin number for data bus[5].
        config LCD_D6_G3_GPIO
            int "DATA6 GREEN3 GPIO"
            default 0
            help
                GPIO pin number for data bus[6].
        config LCD_D7_G4_GPIO
            int "DATA7 GREEN4 GPIO"
            default 45
            help
                GPIO pin number for data bus[7].
        config LCD_D8_G5_GPIO
            int "DATA8 GREEN5 GPIO"
            default 48
            help
                GPIO pin number for data bus[8].
        config LCD_D9_G6_GPIO
            int "DATA9 GREEN6 GPIO"
            default 47
            help
                GPIO pin number for data bus[9].
        config LCD_D10_G7_GPIO
            int "DATA10 GREEN7 GPIO"
            default 21
            help
                GPIO pin number for data bus[10].
        config LCD_D11_R3_GPIO
            int "DATA11 RED3 GPIO"
            default 1
            help
                GPIO pin number for data bus[11].
        config LCD_D12_R4_GPIO
            int "DATA12 RED4 GPIO"
            default 2
            help
                GPIO pin number for data bus[12].
        config LCD_D13_R5_GPIO
            int "DATA13 RED5 GPIO"
            default 42
            help
                GPIO pin number for data bus[13].
        config LCD_D14_R6_GPIO
            int "DATA14 RED6 GPIO"
            default 41
            help
                GPIO pin number for data bus[14].
        config LCD_D15_R7_GPIO
            int "DATA15 RED7 GPIO"
            default 40
            help
                GPIO pin number for data bus[15].
    endmenu

    menu "Touch GPIO assignment"
    config I2C_MASTER_SCL
        int "SCL GPIO Num"
        default 9
        help
            GPIO pin number for I2C Master clock line.

    config I2C_MASTER_SDA
        int "SDA GPIO Num"
        default 8
        help
            GPIO pin number for I2C Master data line.
    endmenu

    menu "Wifi Configuration"

        config ESP_WIFI_SSID
            string "WiFi SSID"
            default "PLAY_Swiatlowodowy_E5DE"
            help
                SSID (network name) to connect to.

        config ESP_WIFI_PASSWORD
            string "WiFi Password"
            default "3fNb3FZq&4@x"
            help
                WiFi password (WPA or WPA2) to use.

        choice ESP_WIFI_SAE_MODE
            prompt "WPA3 SAE mode selection"
            default ESP_STATION_WPA3_SAE_PWE_BOTH
            help
                Select mode for SAE as Hunt and Peck, H2E or both.
            config ESP_STATION_WPA3_SAE_PWE_HUNT_AND_PECK
                bool "HUNT AND PECK"
            config ESP_STATION_WPA3_SAE_PWE_HASH_TO_ELEMENT
                bool "H2E"
                depends on ESP_WIFI_ENABLE_SAE_H2E
            config ESP_STATION_WPA3_SAE_PWE_BOTH
                bool "BOTH"
                depends on ESP_WIFI_ENABLE_SAE_H2E
        endchoice

        config ESP_WIFI_PW_ID
            string "PASSWORD IDENTIFIER"
            depends on  ESP_STATION_WPA3_SAE_PWE_HASH_TO_ELEMENT|| ESP_STATION_WPA3_SAE_PWE_BOTH
            default ""
            help
                password identifier for SAE H2E

        config ESP_MAXIMUM_RETRY
            int "Maximum retry"
            default 5
            help
                Set the Maximum retry to avoid station reconnecting to the AP unlimited when the AP is really inexistent.

        choice ESP_WIFI_SCAN_AUTH_MODE_THRESHOLD
            prompt "WiFi Scan auth mode threshold"
            default ESP_WIFI_AUTH_WPA2_PSK
            help
                The weakest authmode to accept in the scan mode.
                This value defaults to ESP_WIFI_AUTH_WPA2_PSK in case password is present and ESP_WIFI_AUTH_OPEN is used.
                Please select ESP_WIFI_AUTH_WEP/ESP_WIFI_AUTH_WPA_PSK in case AP is operating in WEP/WPA mode.

            config ESP_WIFI_AUTH_OPEN
                bool "OPEN"
            config ESP_WIFI_AUTH_WEP
                bool "WEP"
            config ESP_WIFI_AUTH_WPA_PSK
                bool "WPA PSK"
            config ESP_WIFI_AUTH_WPA2_PSK
                bool "WPA2 PSK"
            config ESP_WIFI_AUTH_WPA_WPA2_PSK
                bool "WPA/WPA2 PSK"
            config ESP_WIFI_AUTH_WPA3_PSK
                bool "WPA3 PSK"
            config ESP_WIFI_AUTH_WPA2_WPA3_PSK
                bool "WPA2/WPA3 PSK"
            config ESP_WIFI_AUTH_WAPI_PSK
                bool "WAPI PSK"
    endchoice

    endmenu
endmenu
```
